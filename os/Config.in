## os/Config.in
```kconfig
source "$BR2_EXTERNAL_CATALYST_PATH/package/m5stack-cardputer-zero/Config.in"
source "$BR2_EXTERNAL_CATALYST_PATH/package/catalyst-camera/Config.in"
source "$BR2_EXTERNAL_CATALYST_PATH/package/catalyst-tailscale/Config.in"
source "$BR2_EXTERNAL_CATALYST_PATH/package/catalyst-yt-dlp/Config.in"
source "$BR2_EXTERNAL_CATALYST_PATH/package/catalyst-fonts-cjk/Config.in"
```

## os/package/catalyst-camera/Config.in
```kconfig
config BR2_PACKAGE_CATALYST_CAMERA
	bool "catalyst-camera"
	depends on BR2_PACKAGE_LIBCAMERA
	depends on BR2_INSTALL_LIBSTDCPP
	select BR2_PACKAGE_JPEG
	help
	  The camera's picture on standard output, for the shell: greyscale
	  for the AprilTag reader, colour with photos (JPEG, through
	  libjpeg) for the Camera app. A small libcamera program in place of
	  rpicam-apps (which needs newer kernel headers than this toolchain
	  has, and Boost).
```

## os/package/catalyst-fonts-cjk/Config.in
```kconfig
config BR2_PACKAGE_CATALYST_FONTS_CJK
	bool "catalyst-fonts-cjk"
	help
	  Noto Sans CJK, cut down to the Chinese, Japanese and Korean
	  characters in everyday use (13,483 of them), for the shell to
	  draw song titles, file names and notes its Latin fonts lack.
	  Installed as /usr/share/fonts/catalyst/NotoSansCJK-Catalyst.otf
	  (5.5 MB), with its licence (SIL Open Font License 1.1).

	  https://github.com/notofonts/noto-cjk
```

## os/package/catalyst-tailscale/Config.in
```kconfig
config BR2_PACKAGE_CATALYST_TAILSCALE
	bool "catalyst-tailscale"
	depends on BR2_PACKAGE_HOST_GO_TARGET_ARCH_SUPPORTS
	select BR2_PACKAGE_HOST_GO
	help
	  Tailscale for the handheld: one small tailscaled with the CLI
	  built in (`tailscale` is a link to it), only the features a
	  client on a kernel TUN needs (Tailscale's own extra-small
	  build). Unlike Buildroot's tailscale package it leaves the
	  kernel's configuration alone: it runs with netfilter off,
	  so nftables, NAT and conntrack are not needed.

	  https://github.com/tailscale/tailscale
```

## os/package/catalyst-unitv/Config.in
```kconfig
config BR2_PACKAGE_CATALYST_UNITV
	bool "catalyst-unitv"
	help
	  What the shell installs on the smart camera (an M5Stack UnitV,
	  K210) over USB-A and the Grove port: Catalyst Coprocessor, a
	  MaixPy of Catalyst's own (MIT and Apache-2.0), Sipeed's YOLOv2
	  face model (MIT), the voice commands' keyword spotter (trained on
	  Speech Commands, CC-BY-4.0), kflash.py's K210 flash loader (MIT)
	  and Catalyst's main.py, in /usr/share/catalyst/unitv (2.4 MB),
	  each with its source and licence.

	  https://github.com/sipeed/MaixPy-v1
```

## os/package/catalyst-yt-dlp/Config.in
```kconfig
config BR2_PACKAGE_CATALYST_YT_DLP
	bool "catalyst-yt-dlp"
	depends on BR2_PACKAGE_PYTHON3
	depends on BR2_PACKAGE_QUICKJS
	select BR2_PACKAGE_PYTHON3_SSL
	select BR2_PACKAGE_PYTHON3_SQLITE
	select BR2_PACKAGE_PYTHON3_PYEXPAT
	select BR2_PACKAGE_PYTHON3_UNICODEDATA
	help
	  yt-dlp's single-file release, for the Music app to find a
	  song's audio stream. It runs the script that answers YouTube's
	  player challenges in QuickJS (qjs).

	  https://github.com/yt-dlp/yt-dlp

comment "catalyst-yt-dlp needs python3 and quickjs"
	depends on !BR2_PACKAGE_PYTHON3 || !BR2_PACKAGE_QUICKJS
```

## os/package/m5stack-cardputer-zero/Config.in
```kconfig
config BR2_PACKAGE_M5STACK_CARDPUTER_ZERO
	bool "m5stack-cardputer-zero"
	depends on BR2_LINUX_KERNEL
	help
	  Out-of-tree drivers and device tree overlays from M5Stack for
	  the CardputerZero: the M5IOE1 I/O expander, the ST7789V3 panel
	  (panel-mipi-dbi) and its PWM backlight, the TCA8418 keyboard,
	  the BQ27220 fuel gauge and the power-fail handler.

	  https://github.com/m5stack/m5stack-linux-dtoverlays
```

## os/package/whisper-cpp/Config.in
```kconfig
config BR2_PACKAGE_WHISPER_CPP
	bool "whisper-cpp"
	depends on BR2_aarch64 # its CPU flags are the CM0's A53's
	depends on BR2_INSTALL_LIBSTDCPP
	depends on BR2_TOOLCHAIN_HAS_THREADS
	depends on BR2_TOOLCHAIN_GCC_AT_LEAST_9
	help
	  whisper.cpp's whisper-server, for offline dictation: speech
	  to text on the handheld with OpenAI's Whisper (tiny.en, which
	  the shell downloads to /data/models when asked). One program,
	  /usr/bin/whisper-server (2 MB), with its own copy of ggml
	  linked in, so it never meets llama.cpp's libggml.

	  https://github.com/ggml-org/whisper.cpp

comment "whisper-cpp needs a toolchain w/ C++, threads, gcc >= 9"
	depends on BR2_aarch64
	depends on !BR2_INSTALL_LIBSTDCPP || !BR2_TOOLCHAIN_HAS_THREADS \
		|| !BR2_TOOLCHAIN_GCC_AT_LEAST_9
```
